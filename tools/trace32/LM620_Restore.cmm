; --------------------------------------------------------------------------------
; @Title: LM620 Ramdump Script
; @Description:
; LM620 TRACE32 ½Å±¾
; @Copyright: (C) 2022 Innochip-Tech genanfeng.
; --------------------------------------------------------------------------------


  LOCAL &ramdump_path &elf_file &last_path &cpu_name

; Detect TRACE32 Type
	 
  &last_path=OS.PPD()

;Create an area which is invisible ...

  AREA.Create PrintData 120. 20000.
  AREA.CLEAR PrintData
;  AREA.Open  PrintData PrintData.txt
  
  PRINT "---------LM620 Ramdump Tool------------------"

;and attach it to a dialog with a simple close button
;The dialog is 40 chars wide and includes 10 lines of text

  WINPOS 50, 0, 120. 30.
  DIALOG.AREA PrintData
  (
        HEADER "LM620 Ramdump Tool"

        POS  1.  0. 9.
        TEXT "Ramdump :"
        POS 10.  0. 30.
RAMDUMP:   EDIT "" "GOSUB set_ramdump_path"

        POS 40. 0. 3. 1.
        BUTTON "..." "GOSUB browse_path RAMDUMP ramdump_path"

        POS  1. 1. 9.
        TEXT "Elf File :"
        POS 10. 1. 30.
ELF:    EDIT "" "GOSUB set_elf_file"

        POS 40. 1. 3. 1.
        BUTTON "..." "GOSUB browse_file ELF elf_file *"

        POS 44. 0. 8. 2.
LOAD:   BUTTON "LOAD" "GOSUB load_ramdump"

        POS 53. 0. 50. 1.
SYSINFO:   dyntext "SYSINFO:"

        POS 53. 1. 50. 1.
ERRINFO:   dyntext "ERRINFO:"

        POS 1. 3. 10. 1.
SHOW_THREAD: BUTTON "ShowThread"
        (
            do show_thread.cmm
        )

        POS 12. 3. 10. 1.
BACK_TRACE: BUTTON "BackTrace"
        (
            &start=Var.Value(exc_trace)
            &end=&start+0x1000
            do backtrace.cmm &start &end
            do frame.cmm  &start
        )

        POS 23. 3. 10. 1.
THREAD_BT: BUTTON "ThreadBT"
        (
            do select_thread.cmm
            ENTRY &thread_struct
            &start=Var.Value(((osThread_t)&thread_struct)->stackAddr)
            &size=Var.Value(((osThread_t)&thread_struct)->stackSize)
            &sp=Var.Value(((osThread_t)&thread_struct)->sp)
            PRINTF "Thread:%16s  0x%08x"  Var.String(((osThread_t)&thread_struct)->name)  &thread_struct
            &end=&size+&start
            do backtrace.cmm  &sp &end
            do frame.cmm  &sp
        )

        POS 34. 3. 10. 1.
ALL_THREAD_BT: BUTTON "AllThreadBT"
        (
            do show_all_backtrace.cmm
        )

        POS 45. 3. 10. 1.
MSG_BOX: BUTTON "MSG Box"
        (
            do show_mailbox.cmm
        )

        POS 56. 3. 10. 1.
MEM_TRC: BUTTON "MemTrace"
        (
            IF "&cpu_name"=="ap"
            (
                do show_ap_meminfo.cmm
            )
            ELSE
            (
                do show_cp_meminfo.cmm
            )
        )

        POS 67. 3. 10. 1.
MEM_SUM: BUTTON "MemSummary"
        (
            IF "&cpu_name"=="ap"
            (
                do show_ap_meminfo_sum.cmm
            )
            ELSE
            (
                do show_cp_meminfo.cmm
            )
        )

        POS 78. 3. 10. 1.
THREAD_SWAP: BUTTON "ThreadSwap"
        (
            do show_thread_swap.cmm
        )

        POS 109. 3. 6. 1.
BTN_CLEAN: BUTTON "Clear"
        (
            AREA.CLEAR PrintData
        )

        ; close button
        POS 115. 3. 6. 1.
CLS_CLEAN: BUTTON "Close" "goto closeDialog"

        ; handle [X] and Escape
        CLOSE "goto closeDialog"
  )

;initialy disable clean button
  DIALOG.DISABLE SHOW_THREAD
  DIALOG.DISABLE BACK_TRACE
  DIALOG.DISABLE THREAD_BT
  DIALOG.DISABLE ALL_THREAD_BT
  DIALOG.DISABLE MSG_BOX
  DIALOG.DISABLE MEM_TRC
  DIALOG.DISABLE MEM_SUM
  DIALOG.DISABLE THREAD_SWAP
  
  STOP

;common jumplabel for closing the dialog and ending script
closeDialog:
  DIALOG.END
  AREA.CLOSE PrintData
  ENDDO

set_ramdump_path:
  LOCAL &str

  &str=DIALOG.STRing(RAMDUMP)
  &ramdump_path="&str"
  RETURN

set_elf_file:
  LOCAL &str

  &str=DIALOG.STRing(ELF)
  &elf_file="&str"
  RETURN

browse_path:
  ENTRY &label &item
  LOCAL &str
  LOCAL &directory

  &directory="&last_path"+"/*"
  DIALOG.DIR &directory
  ENTRY &str
  IF "&str"==""
    RETURN
  &assignment="&"+"&item"+"="+"""&str"""
  &assignment
  DIALOG.Set &label "&str"
  &last_path="&str"
  RETURN

browse_file:
  LOCAL &str &label &item
  ENTRY &label &item &ext

  &str=DIALOG.STRing(&label)
  &str=OS.FILE.PATH("&str")
  IF "&str"!=""
    &str="&last_path"+"/"+"&ext"
  DIALOG.File "&str"
  ENTRY &str
  IF "&str"==""
    RETURN
  &assignment="&"+"&item"+"="+"""&str"""
  &assignment
  DIALOG.Set &label "&str"
  &last_path=OS.FILE.PATH("&str")
  RETURN

load_ramdump:
  LOCAL &str

  IF "&ramdump_path"==""
  (
    PRINT "<Not select ramdump directory>"
    RETURN
  )
  IF "&elf_file"==""
  (
    PRINT "<Not select elf file>"
    RETURN
  )
  &cpu_name=STRing.SPLIT("&elf_file","\",-1)
  IF "&cpu_name"=="cpu-ap.elf"
     &cpu_name="ap"
  IF "&cpu_name"=="cpu-cp.elf"
     &cpu_name="cp"
  &str="&ramdump_path"+"\"+"&cpu_name"+"_PrintData.txt"
  AREA.Open  PrintData &str /Append
  do restore.cmm &ramdump_path &elf_file

  DIALOG.Enable SHOW_THREAD
  DIALOG.Enable BACK_TRACE
  DIALOG.Enable THREAD_BT
  DIALOG.Enable ALL_THREAD_BT
  DIALOG.Enable MSG_BOX
  DIALOG.Enable MEM_TRC
  DIALOG.Enable MEM_SUM
  DIALOG.Enable THREAD_SWAP
  
  Frame.view /Locals /Args
  
  SETUP.DIS AbiNames
  
  do show_sysinfo.cmm
  ENTRY &info
  DIALOG.SET SYSINFO "SYSINFO : "+&info
  do errinfo.cmm
  ENTRY &info
  DIALOG.SET ERRINFO "ERRINFO : "+&info
  
  RETURN

ENDDO