## app/ramdump/Kconfig
```kconfig
# components/ramdump/Kconfig
menu "Ramdump Configuration"

config RT_USING_RAMDUMP
    bool "Enable ramdump support"
    default n
    help
        Enable ramdump to capture memory dumps on system crashes.
        Requires UART device for data transfer.

if RT_USING_RAMDUMP

config RAMDUMP_UART_DEVICE
    string "UART device name for ramdump"
    default "uart2"
    help
        The UART device used for ramdump data transfer.

config RAMDUMP_UART_BAUDRATE
    int "UART baudrate for ramdump"
    default 921600
    help
        High baudrate recommended for faster dump transfer.

config RAMDUMP_ENABLE_STORAGE
    bool "Enable local storage (SD/Flash) for dump"
    default n
    depends on RT_USING_DFS
    help
        Save dump images to local storage instead of UART only.

config RAMDUMP_STORAGE_PATH
    string "Local storage mount point"
    default "/sd"
    depends on RAMDUMP_ENABLE_STORAGE
    help
        Mount point where dump files will be saved.

config RAMDUMP_AUTO_ENTER
    bool "Auto enter ramdump on exception"
    default y
    help
        Automatically enter ramdump CLI when a fault occurs.
        If disabled, exception info is saved but system reboots directly.

config RAMDUMP_ENABLE_CLI
    bool "Enable ramdump MSH commands"
    default y
    depends on RT_USING_FINSH
    help
        Register ramdump and ramdump_test commands in MSH shell.

endif  # RT_USING_RAMDUMP

endmenu
```

## app/usb/Kconfig
```kconfig
# app/usb/Kconfig — USB 栈选择
#
# 只管「编不编哪个栈」。每个栈自己的行为参数（控制器 / FIFO / 优先级 /
# 回环开关）放在该栈目录下的配置头里（st/usb_st_config.h），不进 menuconfig。
# 这样做的好处：参数带单位、带数值约束，能在头文件里写编译期断言。

menu "USB Stack Selection"

config USB_HAL_PCD
    bool
    default n
    help
        Internal switch: pull stm32f4xx_hal_pcd.c / stm32f4xx_hal_pcd_ex.c /
        stm32f4xx_ll_usb.c into the build (bsp/stm32/libraries/STM32F4xx_HAL).
        Selected automatically by a stack that needs the HAL PCD driver.
        Do NOT enable RT_USING_USB instead — that bundle also pulls
        hal_hcd.c / hal_pccard.c which are not part of this trimmed HAL tree.

rsource "cherryusb/Kconfig"
rsource "st/Kconfig"

endmenu
```

## app/usb/cherryusb/Kconfig
```kconfig
# app/usb/cherryusb/Kconfig — CherryUSB 设备栈
#
# 只决定「编不编」。行为参数（控制器 / FIFO / 打印重定向 / DWC2 端口）全部在
# 同目录的 common/usb_config.h 里，便于写编译期断言。

config USB_USE_CHERRYUSB
    bool "CherryUSB device stack (FS controller, app/usb/cherryusb)"
    default n
    help
        Build CherryUSB's device stack from app/usb/cherryusb
        (core/usbd_core.c + class/cdc/usbd_cdc_acm.c + port/dwc2/usb_dc_dwc2.c).

        At present this stack serves the ramdump USB CDC channel
        (RT_USING_RAMDUMP_USB), running OTG_FS in polling mode.
        Parameters live in app/usb/cherryusb/common/usb_config.h.
```

## app/usb/st/Kconfig
```kconfig
# app/usb/st/Kconfig — ST USB Device 栈（本栈私有配置）
#
# 类比 app/ramdump/Kconfig：本栈的所有可见配置项都在这里，不散落到 BSP。

menu "ST USB Device Stack (app/usb/st)"

config USB_USE_ST
    bool "Enable ST USB Device stack (OTG_HS + ULPI/USB3300)"
    default n
    select USB_HAL_PCD
    help
        Build app/usb/st: ST's official USB Device library (HAL port) driving
        OTG_HS through the external USB3300 ULPI PHY, interrupt mode.

        Not the same controller as the CherryUSB polling port in
        app/ramdump/transport/usb (that one uses OTG_FS built-in PHY), so
        both can coexist — but never enable two stacks on the same controller.

        Behaviour knobs (controller, FIFO split, IRQ priority, echo test) are
        plain C macros in app/usb/st/usb_st_config.h, NOT menuconfig items.

endmenu
```

## bsp/stm32/stm32f103-100ask-mini/Kconfig
```kconfig
mainmenu "RT-Thread Configuration"

BSP_DIR := .

RTT_DIR := ../../../os/rt-thread

# 注：RTT_DIR 供 menuconfig 使用（Kconfig 语法只能写相对路径）；构建时 SConstruct 会用
# $PROJECT_ROOT/os/rt-thread 重新定位并校验（见 bsp/stm32/tools/bsp_paths.py），两者须指向同一棵树。

PKGS_DIR := packages

config SOC_STM32F103C8
    bool
    select SOC_SERIES_STM32F1
    select RT_USING_COMPONENTS_INIT
    select RT_USING_USER_MAIN
    default y

source "$(RTT_DIR)/Kconfig"
osource "$PKGS_DIR/Kconfig"
rsource "../libraries/Kconfig"

if !RT_USING_NANO
rsource "board/Kconfig"
endif
```

## os/rt-thread/components/drivers/Kconfig
```kconfig
menu "Device Drivers"

rsource "core/Kconfig"
rsource "ipc/Kconfig"

rsource "serial/Kconfig"
rsource "sdio/Kconfig"
rsource "pin/Kconfig"
rsource "usb/Kconfig"

endmenu
```
